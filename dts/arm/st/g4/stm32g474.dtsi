/*
 * Copyright (c) 2019 STMicroelectronics.
 *
 * SPDX-License-Identifier: Apache-2.0
 */

#include <st/g4/stm32g473.dtsi>

/ {
	soc {
		compatible = "st,stm32g474", "st,stm32g4", "simple-bus";

		crc: crc@40023000 {
			compatible = "st,stm32-crc";
			reg = <0x40023000 0xA0>;
			clocks = <&rcc STM32_CLOCK_BUS_AHB1 0x1000>;

			status = "okay";
		};
	};
};
